## config/boards/arm/planck/Kconfig.planck_right
```kconfig
# mikoto board configuration

# Copyright (c) 2020 The ZMK Contributors
# SPDX-License-Identifier: MIT

config BOARD_PLANCK_LEFT
     select SOC_NRF52840_QIAA
```
